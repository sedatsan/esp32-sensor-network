## firmware/gateway/main/Kconfig.projbuild
```kconfig
menu "Gateway"

config SN_ESPNOW_CHANNEL
    int "Wi-Fi channel in setup mode"
    range 1 13
    default 1
    help
        Channel of the setup access point. Once the gateway joins a network
        it uses the router's channel and nodes find it by scanning.

config SN_PIN_STATUS_LED
    int "Status LED GPIO (DevKit V1 onboard LED)"
    default 2

config SN_SETUP_AP_PASSWORD
    string "Setup access point password (8+ characters)"
    default "sensornet"

config SN_MQTT_TOPIC_PREFIX
    string "MQTT topic prefix"
    default "sensornet"

endmenu
```

## firmware/node/main/Kconfig.projbuild
```kconfig
menu "Sensor node"

config SN_GATEWAY_MAC
    string "Gateway MAC address"
    default "FF:FF:FF:FF:FF:FF"
    help
        Station MAC of the gateway, printed by the gateway at boot.
        The broadcast default works but gets no delivery ACK.

config SN_ESPNOW_CHANNEL
    int "ESP-NOW Wi-Fi channel"
    range 1 13
    default 1

config SN_MAX_TX_POWER_QDBM
    int "Max Wi-Fi TX power in 0.25 dBm units"
    range 8 84
    default 34
    help
        Many ESP32-C3 Super Mini boards have a poorly matched antenna and
        fail to transmit at full power. 34 (8.5 dBm) is plenty for a room.

config SN_REPORT_INTERVAL_S
    int "Report interval in seconds"
    default 300

config SN_PIN_PIR
    int "PIR output GPIO (must be deep-sleep wake capable, GPIO0-5 on C3)"
    default 3

config SN_PIN_TRIG
    int "HC-SR04 TRIG GPIO"
    default 4

config SN_PIN_ECHO
    int "HC-SR04 ECHO GPIO (through a 5V to 3.3V divider)"
    default 5

config SN_DEBUG_STAY_AWAKE
    bool "Bench mode: stay awake and report periodically"
    default n
    help
        Skips deep sleep so the USB console stays attached for debugging.

config SN_DEBUG_PERIOD_MS
    int "Bench mode report period (ms)"
    depends on SN_DEBUG_STAY_AWAKE
    default 3000

endmenu
```

## firmware/node/sdkconfig.defaults
```kconfig
CONFIG_IDF_TARGET="esp32c3"
CONFIG_COMPILER_CXX_EXCEPTIONS=n
CONFIG_COMPILER_CXX_RTTI=n
CONFIG_COMPILER_OPTIMIZATION_SIZE=y
CONFIG_ESP_TASK_WDT_EN=y
CONFIG_ESP_CONSOLE_USB_SERIAL_JTAG=y
```
